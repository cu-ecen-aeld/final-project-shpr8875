## build/conf/bblayers.conf
```bitbake
# POKY_BBLAYERS_CONF_VERSION is increased each time build/conf/bblayers.conf
# changes incompatibly
POKY_BBLAYERS_CONF_VERSION = "2"

BBPATH = "${TOPDIR}"
BBFILES ?= ""

BBLAYERS ?= " \
  /home/shweta/final-project-shpr8875/poky/meta \
  /home/shweta/final-project-shpr8875/poky/meta-poky \
  /home/shweta/final-project-shpr8875/poky/meta-yocto-bsp \
  /home/shweta/final-project-shpr8875/meta-raspberrypi \
  "
```
